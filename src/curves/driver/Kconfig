## src/curves/driver/Kconfig
```kconfig
config INPUT_CURVES_MOUSE_ACCEL
	tristate "Curves mouse acceleration"
	depends on INPUT
	depends on 64BIT
	depends on X86_64
	help
	  Modern mouse acceleration driver.
	  Turns mouse sensitivity into a function of mouse movement speed.
	  Requires 128-bit integer support.
	
	  If unsure, say N.
```
